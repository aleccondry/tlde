## CMakeLists.txt
```
# SPDX-License-Identifier: Apache-2.0
cmake_minimum_required(VERSION 3.20.0)

find_package(Zephyr REQUIRED HINTS $ENV{ZEPHYR_BASE})
project(img_v1_0_0)

target_sources(app PRIVATE src/main.c)
```

## prj.conf
```kconfig
CONFIG_BOOTLOADER_MCUBOOT=y
CONFIG_MCUBOOT_SIGNATURE_KEY_FILE="updatebox/samples/zephyr/mcuboot_flash_img_copy/keys/bad-rsa-2048.pem"
CONFIG_MCUBOOT_IMGTOOL_SIGN_VERSION="1.0.0+0"

CONFIG_DEBUG=n
```

## src/main.c
```c
#include <zephyr/sys/printk.h>

int main(void) {
    printk("Hello world!\n");
    printk("Image version: %s\n", CONFIG_MCUBOOT_IMGTOOL_SIGN_VERSION);
    return 0;
}
```
