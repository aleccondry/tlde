## CMakeLists.txt
```
# Copyright (c) 2024 Nordic Semiconductor ASA
# SPDX-License-Identifier: Apache-2.0

cmake_minimum_required(VERSION 3.20.0)
find_package(Zephyr REQUIRED HINTS $ENV{ZEPHYR_BASE})

project(mcuboot_flash_img_copy)
FILE(GLOB app_sources src/*.c)
target_sources(app PRIVATE ${app_sources})
```

## sample.yaml
```
sample:
  name: mcuboot_flash_img_copy 
tests:
  sample.mcuboot_flash_img_copy:
    sysbuild: true
    build_only: true
    platform_allow:
      - esp32c3_devkitm
      - esp32s3_devkitm/esp32s3/procpu
      - rpi_pico/rp2040/w
      - bbc_microbit_v2
      - qemu_cortex_m0
    integration_platforms:
      - esp32c3_devkitm
      - esp32s3_devkitm/esp32s3/procpu
      - rpi_pico/rp2040/w
      - bbc_microbit_v2
      - qemu_cortex_m0
    tags: ci_build
```

## sysbuild.conf
```
# Sysbuild configuration file.

# Enable MCUboot per default for this sample.
SB_CONFIG_BOOTLOADER_MCUBOOT=y
# Path handling with zephyr 4.1.0 conflicting when it propagates to ninja so as intial build path is good but final path is wrong
# SB_CONFIG_BOOT_SIGNATURE_KEY_FILE="updatebox/samples/zephyr/mcuboot_flash_img_copy/keys/root-rsa-2048.pem"
```

## prj.conf
```kconfig
# Global parameters
CONFIG_MAIN_STACK_SIZE=8192

# Format image for MCUBoot (header,trailer,TLV,...)
CONFIG_BOOTLOADER_MCUBOOT=y
# File path as of version 4.1.0, from 4.2.0 path is relative to the folder
CONFIG_MCUBOOT_SIGNATURE_KEY_FILE="updatebox/samples/zephyr/mcuboot_flash_img_copy/keys/root-rsa-2048.pem"
CONFIG_MCUBOOT_IMGTOOL_SIGN_VERSION="0.0.0+0"

# Minimal configuration for flashing
CONFIG_FLASH=y
CONFIG_FLASH_MAP=y
CONFIG_STREAM_FLASH=y

# Enable reboot for updatebox
CONFIG_REBOOT=y

# Enable MCUBoot for updatebox
CONFIG_IMG_MANAGER=y

# Logging
CONFIG_LOG=y
CONFIG_LOG_DEFAULT_LEVEL=3
```

## src/main.c
```c
/* mcuboot_flash_img_copy: copy an img from flash storage to slo1

    - destination partition is set in Kconfig
    - source partition is passed in the C main
*/

#include <zephyr/drivers/flash.h>
#include <zephyr/logging/log.h>
#include <zephyr/storage/flash_map.h>
LOG_MODULE_REGISTER(mcuboot_flash_img_copy, LOG_LEVEL_DBG);

#include <stdio.h>

#include "mcuboot_flash_img_copy.h"

// Use 'scratch' instead for microbit as storage is too small
#ifdef CONFIG_BOARD_BBC_MICROBIT_V2
    #define STORAGE_PARTITION_LABEL scratch_partition
#else
    #define STORAGE_PARTITION_LABEL storage_partition
#endif

// Select storage partition
#define STORAGE_PARTITION_ID FIXED_PARTITION_ID(STORAGE_PARTITION_LABEL)

int main(void) {
    LOG_INF("Hello World! %s", CONFIG_BOARD_TARGET);

    // Image copy from flash handled by the Rust application
    int rc = ubx_mcuboot_flash_img_copy(STORAGE_PARTITION_ID);
    if (rc < 0) {
        LOG_ERR("ubx_mcuboot_flash_img_copy()...failed(%d)", rc);
        return rc;
    }

    return 0;
}
```

## src/mcuboot_flash_img_copy.c
```c
/*
 * Pure Zephyr C translation of the Rust mcuboot_flash_img_copy module.
 *
 * Copies a firmware image from a source flash partition into slot1_partition,
 * requests a test upgrade via MCUboot, then performs a cold reboot.
 *
 * APIs used:
 *   - flash_area_open / flash_area_close / flash_area_erase / flash_area_write / flash_area_read
 *   - boot_fetch_active_slot / boot_read_bank_header
 *   - mcuboot_swap_type / boot_request_upgrade
 *   - sys_reboot
 */

#include "mcuboot_flash_img_copy.h"

#include <errno.h>

#include <zephyr/dfu/mcuboot.h>
#include <zephyr/drivers/flash.h>
#include <zephyr/logging/log.h>
#include <zephyr/storage/flash_map.h>
#include <zephyr/sys/reboot.h>

LOG_MODULE_DECLARE(mcuboot_flash_img_copy, LOG_LEVEL_DBG);

/* Chunk size used when copying image data between partitions. */
#define FLASH_CHUNK_SIZE 256U

/* -------------------------------------------------------------------------
 * Internal helper: swap-type value → human-readable string
 * ---------------------------------------------------------------------- */

static const char *swap_type_str(int swap_type)
{
    switch (swap_type) {
    case BOOT_SWAP_TYPE_NONE:    return "NONE";
    case BOOT_SWAP_TYPE_TEST:    return "TEST";
    case BOOT_SWAP_TYPE_PERM:    return "PERM";
    case BOOT_SWAP_TYPE_REVERT:  return "REVERT";
    case BOOT_SWAP_TYPE_FAIL:    return "FAIL";
    default:                     return "UNKNOWN";
    }
}

/* -------------------------------------------------------------------------
 * Private implementation (mirrors Rust mcuboot_flash_img_copy())
 * ---------------------------------------------------------------------- */

static int mcuboot_flash_img_copy(uint8_t partition_id_src)
{
    int err;

    LOG_INF("Updatebox: copy image from storage to slot1");

    /* -----------------------------------------------------------------
     * Log active-slot / swap-type information.
     * --------------------------------------------------------------- */
    uint8_t flash_area_id = boot_fetch_active_slot();
    int swap = mcuboot_swap_type();

    LOG_INF("Swap type: %s (%d)", swap_type_str(swap), swap);
    LOG_INF("Active partition id: %u", (unsigned)flash_area_id);

    /* -----------------------------------------------------------------
     * Read and log the image header from the active slot.
     * --------------------------------------------------------------- */
    struct mcuboot_img_header boot_header;

    err = boot_read_bank_header(flash_area_id, &boot_header, sizeof(boot_header));
    if (err) {
        LOG_ERR("boot_read_bank_header() failed: %d", err);
        return err;
    }

    const struct mcuboot_img_sem_ver *ver = &boot_header.h.v1.sem_ver;

    LOG_INF("Image Version: %u.%u.%u (build %u)",
            (unsigned)ver->major,
            (unsigned)ver->minor,
            (unsigned)ver->revision,
            (unsigned)ver->build_num);

    /* -----------------------------------------------------------------
     * Open source and destination flash partitions.
     * --------------------------------------------------------------- */
    const struct flash_area *fa_dest;
    const struct flash_area *fa_src;

    err = flash_area_open(FIXED_PARTITION_ID(slot1_partition), &fa_dest);
    if (err) {
        LOG_ERR("failed to open slot1_partition: %d", err);
        return err;
    }

    LOG_INF("dest partition size: %zu bytes, offset: 0x%lx",
            (size_t)fa_dest->fa_size, (unsigned long)fa_dest->fa_off);

    err = flash_area_open(partition_id_src, &fa_src);
    if (err) {
        LOG_ERR("failed to open source partition %u: %d",
                (unsigned)partition_id_src, err);
        flash_area_close(fa_dest);
        return err;
    }

    /* -----------------------------------------------------------------
     * Determine copy size: minimum of the two partition sizes.
     * --------------------------------------------------------------- */
    size_t copy_size = fa_src->fa_size < fa_dest->fa_size
                       ? fa_src->fa_size
                       : fa_dest->fa_size;

    /* copy_size must be an exact multiple of FLASH_CHUNK_SIZE. */
    if (copy_size % FLASH_CHUNK_SIZE != 0) {
        LOG_ERR("copy_size %zu is not a multiple of chunk size %u",
                copy_size, FLASH_CHUNK_SIZE);
        err = -EINVAL;
        goto close_both;
    }

    uint32_t nb_chunks = (uint32_t)(copy_size / FLASH_CHUNK_SIZE);

    /* -----------------------------------------------------------------
     * Erase the destination partition.
     * --------------------------------------------------------------- */
    err = flash_area_erase(fa_dest, 0, copy_size);
    if (err) {
        LOG_ERR("erase of slot1_partition failed: %d", err);
        goto close_both;
    }

    LOG_INF("erased %zu bytes", copy_size);

    /* -----------------------------------------------------------------
     * Copy image in FLASH_CHUNK_SIZE chunks.
     * --------------------------------------------------------------- */
    uint8_t copy_buffer[FLASH_CHUNK_SIZE];

    LOG_INF("Copy %u chunks of %u B", (unsigned)nb_chunks, FLASH_CHUNK_SIZE);

    for (uint32_t chunk = 0; chunk < nb_chunks; chunk++) {
        off_t offset = (off_t)(chunk * FLASH_CHUNK_SIZE);

        err = flash_area_read(fa_src, offset, copy_buffer, FLASH_CHUNK_SIZE);
        if (err) {
            LOG_ERR("read failed at offset 0x%lx: %d",
                    (unsigned long)offset, err);
            goto close_both;
        }

        err = flash_area_write(fa_dest, offset, copy_buffer, FLASH_CHUNK_SIZE);
        if (err) {
            LOG_ERR("write failed at offset 0x%lx: %d",
                    (unsigned long)offset, err);
            goto close_both;
        }
    }

    /* -----------------------------------------------------------------
     * Request a test upgrade and log the new swap type.
     * --------------------------------------------------------------- */
    LOG_INF("Requesting test upgrade");

    err = boot_request_upgrade(BOOT_UPGRADE_TEST);
    if (err) {
        LOG_ERR("boot_request_upgrade() failed: %d", err);
        goto close_both;
    }

    swap = mcuboot_swap_type();
    LOG_INF("Swap type: %s (%d)", swap_type_str(swap), swap);

close_both:
    flash_area_close(fa_src);
    flash_area_close(fa_dest);
    return err;
}

/* -------------------------------------------------------------------------
 * Public C API
 * ---------------------------------------------------------------------- */

int ubx_mcuboot_flash_img_copy(uint8_t partition_id_src)
{
    int err = mcuboot_flash_img_copy(partition_id_src);

    if (err) {
        LOG_ERR("mcuboot_flash_img_copy() failed: %d", err);
        return err;
    }

    LOG_INF("Will attempt to reboot device");

    /* sys_reboot() does not return on success. */
    sys_reboot(SYS_REBOOT_COLD);

    /* Unreachable, but satisfies the compiler. */
    return -EIO;
}
```

## src/mcuboot_flash_img_copy.h
```c
#ifndef MCUBOOT_FLASH_IMG_COPY_H
#define MCUBOOT_FLASH_IMG_COPY_H

#include <stdint.h>

/**
 * @brief Copy a firmware image from @p partition_id_src into slot1_partition,
 *        request a MCUboot test upgrade, then perform a cold reboot.
 *
 * This function never returns on success because it reboots the device.
 * It only returns a negative errno value if an error occurs before the reboot.
 *
 * @param partition_id_src  flash_area ID of the source partition
 *                          (e.g. FIXED_PARTITION_ID(scratch_partition)).
 * @return Negative errno on failure; does not return on success.
 */
int ubx_mcuboot_flash_img_copy(uint8_t partition_id_src);

#endif /* MCUBOOT_FLASH_IMG_COPY_H */
```
